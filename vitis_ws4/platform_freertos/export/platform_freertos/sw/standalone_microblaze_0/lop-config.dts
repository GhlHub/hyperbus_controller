
/dts-v1/;
/ {
        compatible = "system-device-tree-v1,lop";
        lops {
                lop_0 {
                        compatible = "system-device-tree-v1,lop,load";
                        load = "assists/baremetal_validate_comp_xlnx.py";
                };
    
                lop_1 {
                    compatible = "system-device-tree-v1,lop,assist-v1";
                    node = "/";
                    outdir = "/raid/work/hyperbus_controller_freertos_port/vitis_ws4/platform_freertos/export/platform_freertos/sw/standalone_microblaze_0";
                    id = "module,baremetal_validate_comp_xlnx";
                    options = "microblaze_0 /tools/Xilinx/2025.2/Vitis/data/embeddedsw/lib/sw_apps/hello_world/src /raid/work/hyperbus_controller_freertos_port/vitis_ws4/_ide/.wsdata/.repo.yaml";
                };
        
        };
    };
    